## Kconfig.defconfig
```kconfig
if SHIELD_SKELETYL_LEFT

config ZMK_KEYBOARD_NAME
    default "Skeletyl"

config ZMK_SPLIT_ROLE_CENTRAL
    default y

config ZMK_SPLIT_BLE_CENTRAL_PERIPHERALS
    default 1

endif


if SHIELD_SKELETYL_RIGHT

config ZMK_KEYBOARD_NAME
    default "Skeletyl Right"

config ZMK_SPLIT_ROLE_CENTRAL
    default n

endif
```

## config/boards/shields/skeletyl_left/Kconfig.defconfig
```kconfig
if SHIELD_SKELETYL_LEFT

config ZMK_KEYBOARD_NAME
	default "Skeletyl"

config ZMK_SPLIT_ROLE_CENTRAL
	default y

config ZMK_SPLIT_BLE_CENTRAL_PERIPHERALS
	default 1

endif
```

## config/boards/shields/skeletyl_right/Kconfig.defconfig
```kconfig
if SHIELD_SKELETYL_RIGHT

config ZMK_KEYBOARD_NAME
    default "Skeletyl Right"

config ZMK_SPLIT_ROLE_CENTRAL
    default n
    
config ZMK_SPLIT_BLE_ROLE_PERIPHERAL
    default y

endif
```
