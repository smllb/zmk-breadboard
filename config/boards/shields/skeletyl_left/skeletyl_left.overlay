#include "skeletyl_matrix.dtsi"

&kscan0 {
	col-gpios =
		<&gpio0 2 GPIO_ACTIVE_HIGH>    // COL 1 - D19 (P0.02)
		, <&gpio1 15 GPIO_ACTIVE_HIGH> // COL 2 - D18 (P1.15)
		, <&gpio1 11 GPIO_ACTIVE_HIGH> // COL 3 - D14 (P1.11)
		, <&gpio0 10 GPIO_ACTIVE_HIGH> // COL 4 - D16 (P0.10)
		, <&gpio0 17 GPIO_ACTIVE_HIGH> // COL 5 - D2  (P0.17)
		, <&gpio0 20 GPIO_ACTIVE_HIGH> // COL 6 - D3  (P0.20)
		;
	row-gpios =
		<&gpio0 11 (GPIO_ACTIVE_HIGH | GPIO_PULL_DOWN)> // ROW 1 - D7 (P0.11)
		, <&gpio1 0 (GPIO_ACTIVE_HIGH | GPIO_PULL_DOWN)>  // ROW 2 - D6 (P1.00)
		, <&gpio1 4 (GPIO_ACTIVE_HIGH | GPIO_PULL_DOWN)>  // ROW 3 - D8 (P1.04)
		, <&gpio0 24 (GPIO_ACTIVE_HIGH | GPIO_PULL_DOWN)> // ROW 4 - D5 (P0.24)
		;
};
